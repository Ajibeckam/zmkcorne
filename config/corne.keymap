/*
 * Copyright (c) 2020 The ZMK Contributors
 *
 * SPDX-License-Identifier: MIT
 */

#include <behaviors.dtsi>
#include <dt-bindings/zmk/keys.h>
#include <dt-bindings/zmk/bt.h>
#include <dt-bindings/zmk/output.h>
#include "keymap_italian.h"

// Layer Definitons
        #define BASE 0
        #define SYM 1
        #define EXT 2
        #define FNC 3
        #define SYM2 4
        #define ACCENT 5
        #define SETTINGS 6
// -------

#&sk {
	// don't release mods on other mods presses
    ignore-modifiers;
};

/ {
	macros {
		// sometimes my device thinks a modifier is being held down
		// pressing all modifiers fixes it.
		unstick: unstick {
			label = "ZM_unstick";
			compatible = "zmk,behavior-macro";
			#binding-cells = <0>;
			bindings = <&kp LSHIFT &kp RSHIFT &kp LCTRL &kp RCTRL &kp LALT &kp RALT &kp LGUI &kp RGUI>;
		};
	};

        combos {
		compatible = "zmk,combos";
		// both right thumb keys
        combo_accent {
			timeout-ms = <200>;
			key-positions = <32 33>;
			bindings = <&mo ACCENT>;
        };
		// internal-left & external-right thumb keys
		combo_sym2 {
			timeout-ms = <200>;
			key-positions = <31 33>;
			bindings = <&mo SYM2>;
		};
		// both left thumb keys
		combo_settings {
			timeout-ms = <200>;
			key-positions = <30 31>;
			bindings = <&mo SETTINGS>;
		};
    };
        };
}; 
